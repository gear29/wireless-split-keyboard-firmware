## boards/shields/wireless_split/Kconfig.defconfig
```kconfig
if SHIELD_WIRELESS_SPLIT_LEFT

    config ZMK_KEYBOARD_NAME
        default "Wireless Split"

    config ZMK_SPLIT_ROLE_CENTRAL
        default y

endif

if SHIELD_WIRELESS_SPLIT_LEFT || SHIELD_WIRELESS_SPLIT_RIGHT

    config ZMK_SPLIT
        default y

endif
```

## boards/shields/wireless_split/Kconfig.shield
```kconfig
config SHIELD_WIRELESS_SPLIT_LEFT
    def_bool $(shields_list_contains,wireless_split_left)

config SHIELD_WIRELESS_SPLIT_RIGHT
    def_bool $(shields_list_contains,wireless_split_right)
```
